## firmware/main/Kconfig.projbuild
```kconfig
menu "Doorbell"

config DOORBELL_HOSTNAME
    string "Hostname (mDNS name, DHCP name)"
    default "doorbell"

config DOORBELL_RING_TIMEOUT_S
    int "Emulator: the panel stops calling after (s)"
    default 45

config DOORBELL_TALK_TIMEOUT_S
    int "Emulator: the panel ends the conversation after (s)"
    default 120

config DOORBELL_DOOR_PULSE_MS
    int "How long the open button is held (ms)"
    default 1000

endmenu
```

## firmware/sdkconfig.defaults
```kconfig
CONFIG_ESPTOOLPY_FLASHSIZE_4MB=y
CONFIG_HTTPD_WS_SUPPORT=y
CONFIG_HTTPD_MAX_REQ_HDR_LEN=1024
CONFIG_ESP_MAIN_TASK_STACK_SIZE=4096
CONFIG_PARTITION_TABLE_SINGLE_APP_LARGE=y
```
